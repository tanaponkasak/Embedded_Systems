/*******************************************************************************
 * ET-ESP32(WROVER) RS485 V2 
 * Tools->Board:"ESP32 Wrover Module"
 *******************************************************************************
 * I2C Interface & I2C Bus
 * -> IO22                = I2C_SCL
 * -> IO21                = I2C_SDA
 * -> I2C RTC:DS3231      = I2C Address : 0x68:1100100(x)
 * -> I2C EEPROM 24LC16   = I2C Address : 0x50:1010000(x)
 * -> I2C ADC MCP3423     = I2C Address : 0x6D:1100101(x)
 * -> I2C Sensor:BME280   = I2C Address : 0x76:1110110(x)
 * -> I2C Sebsor:SHT31    = I2C Address : 0x44:1000100(x)/0x45:1010101(x)
 * SPI Interface SD Card
 * -> SD_CS               = IO4
 * -> SPI_MISO            = IO19
 * -> SPI_MOSI            = IO23
 * -> SPI_SCK             = IO18
 * UART2 RS485 Half Duplex Auto Direction
 * -> IO26                = RX2
 * -> IO27                = TX2
 * User Switch
 * -> IO36                = USER_SW
 * RTC Interrupt
 * -> IO39                = RTC_INT#
 *******************************************************************************/
 
//=================================================================================================
#include <Wire.h> 
//=================================================================================================

//=================================================================================================
// Start of Default Hardware : ET-ESP32(WROVER) RS485 V2
//=================================================================================================
// Remap Pin USART -> C:\Users\Admin\Documents\Arduino\hardware\espressif\esp32\cores\esp32\HardwareSerial.cpp
//                    C:\Users\Admin\AppData\Local\Arduino15\packages\esp32\hardware\esp32\1.0.0\cores\esp32\HardwareSerial.cpp
//=================================================================================================
#include <HardwareSerial.h>
//=================================================================================================
#define SerialDebug           Serial                                                              // USB Serial(Serial0)
//=================================================================================================
#define SerialRS485_RX_PIN    26
#define SerialRS485_TX_PIN    27
#define SerialRS485           Serial2                                                             // Serial2(IO27=TXD,IO26=RXD)
//=================================================================================================
#define SerialLora_RX_PIN     14
#define SerialLora_TX_PIN     13
#define SerialLora            Serial1                                                             // Serial1(IO13=TXD,IO14=RXD)
//=================================================================================================
#define LORA_RES_PIN          33                                                                  // ESP32-WROVER :IO33(LoRa-RESET)
#define LORA_RES_PRESS        LOW
#define LORA_RES_RELEASE      HIGH
//=================================================================================================
#define I2C_SCL_PIN           22                                                                  // ESP32-WROVER : IO22(SCL1)
#define I2C_SDA_PIN           21                                                                  // ESP32-WROVER : IO21(SDA1)
//=================================================================================================
#define LED_PIN               2                                                                   // ESP-WROVER  : IO2
#define LedON                 1
#define LedOFF                0
//=================================================================================================
#define USER_SW_PIN           36                                                                  // ESP32-WROVER :IO36
#define SW_PRESS              LOW
#define SW_RELEASE            HIGH 
//=================================================================================================
#define RTC_INT_PIN           39                                                                  // ESP32-WROVER :IO39
#define RTC_INT_ACTIVE        LOW
#define RTC_INT_DEACTIVE      HIGH 
//=================================================================================================
// End of Default Hardware : ET-ESP32(WROVER) RS485 V2
//=================================================================================================

//=================================================================================================
// Start of MQTT
//=================================================================================================
#include <WiFi.h>
#include <PubSubClient.h>
//=================================================================================================
#define WIFI_SSID     ""
#define WIFI_PASSWORD ""
//=================================================================================================
#define MQTT_SERVER   ""
#define MQTT_PORT     12345
#define MQTT_USERNAME ""
#define MQTT_PASSWORD ""
#define MQTT_DEV_NAME "ESP32_NODE_001"
//=================================================================================================
#define LED_PIN 2
//=================================================================================================
WiFiClient client;
PubSubClient mqtt(client);
//=================================================================================================

//=================================================================================================
unsigned long lastConnectMQTTTime = 0;
unsigned long previousmqtt = 0;
const long intervalmqtt = 30000ul;                                                                // 30 Second
String payload = "";
//=================================================================================================

//=================================================================================================
// Dummy Sensor Buffer For Test
//=================================================================================================
float sht31_temperature;
float sht31_humidity;  
//=================================================================================================
#define SEALEVELPRESSURE_HPA (1013.25)
//=================================================================================================
float bme280_temperature;
float bme280_humidity;
float bme280_pressure;  
float bme280_altitude;
//=================================================================================================

//=================================================================================================
// mqtt response
//=================================================================================================
void callback(char* topic, byte* payload, unsigned int length) 
{
  //===============================================================================================
  payload[length] = '\0';
  //===============================================================================================
  String topic_str = topic, payload_str = (char*)payload;
  //===============================================================================================
  Serial.println("[" + topic_str + "]: " + payload_str);
  //===============================================================================================
  //digitalWrite(RELAY_PIN, (payload_str == "ON") ? HIGH : LOW);
  //===============================================================================================
}
//=================================================================================================

void setup() 
{
  //===============================================================================================
  // Start of Initial Default Hardware : ET-ESP32(WROVER) RS485 V2
  //===============================================================================================
  pinMode(LED_PIN, OUTPUT);
  digitalWrite(LED_PIN, LedOFF);
  //===============================================================================================
  pinMode(USER_SW_PIN,INPUT_PULLUP);
  pinMode(RTC_INT_PIN,INPUT_PULLUP);
  //===============================================================================================
  Wire.begin(I2C_SDA_PIN,I2C_SCL_PIN);                                                      
  //===============================================================================================
  SerialDebug.begin(115200);
  while(!SerialDebug);
  //===============================================================================================
  SerialRS485.begin(9600, SERIAL_8N1, SerialRS485_RX_PIN, SerialRS485_TX_PIN);
  while(!SerialRS485);
  //===============================================================================================
  // End of Initial Default Hardware : ET-ESP32(WROVER) RS485 V2
  //===============================================================================================

  //===============================================================================================
  SerialDebug.println();
  SerialDebug.println("ET-ESP32(WROVER)RS485 V2.....Ready");
  //===============================================================================================
  
  //===============================================================================================
  SerialDebug.println();
  SerialDebug.print("WiFi Connecting to...");
  SerialDebug.println(WIFI_SSID);
  //===============================================================================================
  WiFi.mode(WIFI_STA);
  WiFi.begin(WIFI_SSID, WIFI_PASSWORD);
  //===============================================================================================
  while (WiFi.status() != WL_CONNECTED) 
  {
    if((millis() - lastConnectMQTTTime) > 500ul)                                                  // 500mS
    {
      SerialDebug.print(".");
      digitalWrite(LED_PIN, !digitalRead(LED_PIN));
      lastConnectMQTTTime = millis();
    }
  }
  //===============================================================================================
  digitalWrite(LED_PIN, LedON);
  //===============================================================================================
  SerialDebug.println();
  SerialDebug.println("WiFi connected");
  SerialDebug.println("IP address: ");
  SerialDebug.println(WiFi.localIP());
  //===============================================================================================
  mqtt.setServer(MQTT_SERVER, MQTT_PORT);
  mqtt.setCallback(callback);
  //===============================================================================================

  //===============================================================================================
  sht31_temperature = 25.0;                                                                       // *C
  sht31_humidity = 50.0;                                                                          // %RH
  //===============================================================================================
  bme280_temperature  = 26.0;                                                                     // *C
  bme280_pressure     = 1001;                                                                     // hPa 
  bme280_altitude     = 41;                                                                       // m
  bme280_humidity     = 51.0;                                                                     // %RH
  //===============================================================================================
}

void loop() 
{
  //===============================================================================================
  if(mqtt.connected() == false) 
  {
    SerialDebug.print("MQTT Re-Connecting...");
    if(mqtt.connect(MQTT_DEV_NAME, MQTT_USERNAME, MQTT_PASSWORD)) 
    {
      //===========================================================================================
      SerialDebug.println("Connected");
      //===========================================================================================
      mqtt.subscribe("/ESP32_NODE_001/RELAY");
      //===========================================================================================
    } 
    else 
    {
      SerialDebug.println("Failed");
      delay(5000);
    }
  } 
  else 
  {
    mqtt.loop();
  }
  //===============================================================================================
  
  //===============================================================================================
  // Start of MQTT Service
  //===============================================================================================
  if(millis() - lastConnectMQTTTime > intervalmqtt)                                               // 15-Second
  {
    //=============================================================================================
    // mqtt.publish("Topic","Message");                                                   
    //=============================================================================================
    payload = String(sht31_temperature);                                                          // SHT31 Temperature
    mqtt.publish("/ESP32_NODE_001/SHT31/Temp", (char*)payload.c_str());
    //=============================================================================================
    payload = String(sht31_humidity);                                                             // SHT31 Humidity
    mqtt.publish("/ESP32_NODE_001/SHT31/Humi", (char*)payload.c_str());
    //=============================================================================================
    payload = String(bme280_temperature);                                                         // BME280 Temperature
    mqtt.publish("/ESP32_NODE_001/BME280/Temp", (char*)payload.c_str());
    //=============================================================================================
    payload = String(bme280_humidity);                                                            // BME280 Humidity
    mqtt.publish("/ESP32_NODE_001/BME280/Humi", (char*)payload.c_str());
    //=============================================================================================
    payload = String(bme280_pressure);                                                            // BME280 Pressure
    mqtt.publish("/ESP32_NODE_001/BME280/Pressure", (char*)payload.c_str());
    //=============================================================================================
    payload = String(bme280_altitude);                                                            // BME280 Altitude    
    mqtt.publish("/ESP32_NODE_001/BME280/Altitude", (char*)payload.c_str());
    //=============================================================================================

    //=============================================================================================
    lastConnectMQTTTime = millis();
    //=============================================================================================
  } 
  //===============================================================================================  
}

