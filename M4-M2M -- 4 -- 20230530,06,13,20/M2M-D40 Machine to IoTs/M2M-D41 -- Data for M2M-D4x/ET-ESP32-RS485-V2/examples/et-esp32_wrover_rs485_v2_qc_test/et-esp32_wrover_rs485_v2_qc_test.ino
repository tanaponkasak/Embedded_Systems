/*******************************************************************************
 * ET-ESP32(WROVER) RS485 V2 
 * Tools->Board:"ESP32 Wrover Module"
 *******************************************************************************
 * I2C Interface & I2C Bus
 * -> IO22                = I2C_SCL
 * -> IO21                = I2C_SDA
 * -> I2C RTC:DS3231      = I2C Address : 0x68:1100100(x)
 * -> I2C EEPROM 24LC16   = I2C Address : 0x50:1010000(x)
 * -> I2C ADC MCP3423     = I2C Address : 0x6D:1100101(x)
 * -> I2C Sensor:BME280   = I2C Address : 0x76:1110110(x)
 * -> I2C Sebsor:SHT31    = I2C Address : 0x44:1000100(x)/0x45:1010101(x)
 * SPI Interface SD Card
 * -> SD_CS               = IO4
 * -> SPI_MISO            = IO19
 * -> SPI_MOSI            = IO23
 * -> SPI_SCK             = IO18
 * UART2 RS485 Half Duplex Auto Direction
 * -> IO26                = RX2
 * -> IO27                = TX2
 * User Switch
 * -> IO36                = USER_SW
 * RTC Interrupt
 * -> IO39                = RTC_INT#
 *******************************************************************************/
 
//=================================================================================================
#include <Wire.h> 
#include "ETT_PCF8574.h"
//=================================================================================================

//=================================================================================================
// Start of Default Hardware : ET-ESP32(WROVER) RS485 V2
//=================================================================================================
// Remap Pin USART -> C:\Users\Admin\Documents\Arduino\hardware\espressif\esp32\cores\esp32\HardwareSerial.cpp
//                    C:\Users\Admin\AppData\Local\Arduino15\packages\esp32\hardware\esp32\1.0.0\cores\esp32\HardwareSerial.cpp
//=================================================================================================
#define SerialDebug           Serial                                                              // USB Serial(Serial0)
//=================================================================================================
#define SerialRS485_RX_PIN    26
#define SerialRS485_TX_PIN    27
#define SerialRS485           Serial2                                                             // Serial2(IO27=TXD,IO26=RXD)
//=================================================================================================
#define SerialLora_RX_PIN     14
#define SerialLora_TX_PIN     13
#define SerialLora            Serial1                                                             // Serial1(IO13=TXD,IO14=RXD)
//=================================================================================================
#define LORA_RES_PIN          33                                                                  // ESP32-WROVER :IO33(LoRa-RESET)
#define LORA_RES_PRESS        LOW
#define LORA_RES_RELEASE      HIGH
//=================================================================================================
#define I2C_SCL_PIN           22                                                                  // ESP32-WROVER : IO22(SCL1)
#define I2C_SDA_PIN           21                                                                  // ESP32-WROVER : IO21(SDA1)
//=================================================================================================
#define LED_PIN               2                                                                   // ESP-WROVER  : IO2
#define LedON                 1
#define LedOFF                0
//=================================================================================================
#define USER_SW_PIN           36                                                                  // ESP32-WROVER :IO36
#define SW_PRESS              LOW
#define SW_RELEASE            HIGH 
//=================================================================================================
#define RTC_INT_PIN           39                                                                  // ESP32-WROVER :IO39
#define RTC_INT_ACTIVE        LOW
#define RTC_INT_DEACTIVE      HIGH 
//=================================================================================================
// End of Default Hardware : ET-ESP32(WROVER) RS485 V2
//=================================================================================================

//=================================================================================================
ETT_PCF8574 master_relay(PCF8574_ID_DEV0);                                                        // ET-ESP32-RS485  : Output Relay(PCF8574:ID7)
//ETT_PCF8574 master_relay(PCF8574A_ID_DEV0);                                                       // ET-ESP32-RS485  : Output Relay(PCF8574:ID7)
//=================================================================================================
uint8_t state;
unsigned long lastGetDelayTime = 0;
//=================================================================================================

//=================================================================================================
#include "Adafruit_SHT31.h"
//=================================================================================================
Adafruit_SHT31 sht31 = Adafruit_SHT31();                                                          // I2C
//=================================================================================================
float sht31_temperature;
float sht31_humidity;  
//=================================================================================================

//=================================================================================================
// ET_DS3231.h
//=================================================================================================
#include "ET_DS3231.h"
//=================================================================================================
#define RTC_INT_PIN          39                                                                   // ESP32-WROVER :IO39
//=================================================================================================
ET_DS3231 myRTC;
DateTime myTimeNow;
//=================================================================================================
float UTCOffset = +7.0;    // Your timezone relative to UTC (http://en.wikipedia.org/wiki/UTC_offset)
char daysOfTheWeek[8][12] = {"Sunday", "Monday", "Tuesday", "Wednesday", "Thursday", "Friday", "Saturday", "Sunday"};
//=================================================================================================
unsigned long lastSecondTime = 0;
//=================================================================================================

//=================================================================================================
#include "ETT_24LC16B.h"
//=================================================================================================
ETT_24LC16B myConfig = ETT_24LC16B(0x50);
//=================================================================================================

//=================================================================================================
#include "ETT_MCP342x.h"
//=================================================================================================
// MCP3423
// CH1 = +VBAT Level Sensor
// CH2 = 4..20mA Sensor
// ADR1 = Float, ADR0 = Low : Slave ID = 1101001x = 0x69
// ADR1 = Float, ADR0 = High: Slave ID = 1101101x = 0x6D
//=================================================================================================
ETT_MCP342X mcp3423(0x6D);
//=================================================================================================
int16_t adc1_value;
float adc1_voltage;
//=================================================================================================
int16_t adc2_value;
float adc2_voltage;
//=================================================================================================
bool mcp3423_status;
//=================================================================================================

//=================================================================================================
unsigned long lastGetI2CSensorTime = 0;
//=================================================================================================


//=================================================================================================
// Start of RS485 Command Variable
// <STX><ID0><ID1><Sep1><Relay><Sep2><Operate><Enter>
// <STX><ID0><ID1><:><0><=><0><CR>   OFF Relay[0]
// <STX><ID0><ID1><:><0><=><1><CR>   ON  Relay[0]
// <STX><ID0><ID1><:><1><=><0><CR>   OFF Relay[1]
// <STX><ID0><ID1><:><1><=><1><CR>   ON  Relay[1]
// <STX><ID0><ID1><:><2><=><0><CR>   OFF Relay[2]
// <STX><ID0><ID1><:><2><=><1><CR>   ON  Relay[2]
// <STX><ID0><ID1><:><3><=><0><CR>   OFF Relay[3]
// <STX><ID0><ID1><:><3><=><1><CR>   ON  Relay[3]
//=================================================================================================
static union  
{
  byte cmd_buff[9];                                                                               // 8 Byte Max
  //===============================================================================================
  // <STX><ID0><ID1><Sep1><Relay><Sep2><Operate><Enter>
  // <STX><ID0><ID1><:><0><=><0><CR>   OFF Relay[0]
  // <STX><ID0><ID1><:><0><=><1><CR>   ON  Relay[0]
  // <STX><ID0><ID1><:><1><=><0><CR>   OFF Relay[1]
  // <STX><ID0><ID1><:><1><=><1><CR>   ON  Relay[1]
  // <STX><ID0><ID1><:><2><=><0><CR>   OFF Relay[2]
  // <STX><ID0><ID1><:><2><=><1><CR>   ON  Relay[2]
  // <STX><ID0><ID1><:><3><=><0><CR>   OFF Relay[3]
  // <STX><ID0><ID1><:><3><=><1><CR>   ON  Relay[3]
  //===============================================================================================
  struct 
  {
    //=============================================================================================
    byte head;                          // <STX>:'*'                                                                       
    byte id[2];                         // ID[0:1}:'00'..'31'  
    byte sep1;                          // ':'
    byte relay;                         // '0':Relay[0],'1':Relay[1],'2':Relay[2],'3':Relay[3]
    byte sep2;                          // '=' 
    byte operate;                       // '0':OFF,'1':ON
    byte enter;                         // <Cr>:0x0D
    //=============================================================================================
  }control_relay;
  //===============================================================================================
  
}rs485;
//=================================================================================================

//=================================================================================================
const byte      STX_CODE                = '*';
//=================================================================================================
const byte      END_CODE                = 0x0D;
//=================================================================================================
const byte      SEP1                    = ':';  
//=================================================================================================
const byte      SEP2                    = '=';
//=================================================================================================
const byte      RELAY0                  = '0';  
const byte      RELAY1                  = '1';
const byte      RELAY2                  = '2';  
const byte      RELAY3                  = '3';
//=================================================================================================
const byte      CMD_RELAY_ON            = '0';  
const byte      CMD_RELAY_OFF           = '1';
//=================================================================================================
static byte *rs485_cmd_ptr;
static byte rs485_chr;
static byte rs485_cmd_head = 0;
static byte rs485_cmd_cnt = 0;  
//=================================================================================================

//=================================================================================================
#include <WiFi.h>
//=================================================================================================
//const char* wifissid = "your-ssid";
//const char* password = "your-password";
const char* wifissid = "ETT_3bb_wlan";
const char* password = "027121120";
//=================================================================================================

void setup() 
{
  //===============================================================================================
  // Start of Initial Default Hardware : ET-ESP32(WROVER) RS485 V2
  //===============================================================================================
  pinMode(LED_PIN, OUTPUT);
  digitalWrite(LED_PIN, LedOFF);
  //===============================================================================================
  pinMode(USER_SW_PIN,INPUT_PULLUP);
  pinMode(RTC_INT_PIN,INPUT_PULLUP);
  //===============================================================================================
  Wire.begin(I2C_SDA_PIN,I2C_SCL_PIN);                                                      
  //===============================================================================================
  SerialDebug.begin(115200);
  while(!SerialDebug);
  //===============================================================================================
  // End of Initial Default Hardware : ET-ESP32(WROVER) RS485 V2
  //===============================================================================================

  //===============================================================================================
  master_relay.begin(0xFF);
  //===============================================================================================
  master_relay.writePin(RELAY_OUT3_PIN, RELAY_OFF);
  master_relay.writePin(RELAY_OUT2_PIN, RELAY_OFF);
  master_relay.writePin(RELAY_OUT1_PIN, RELAY_OFF);
  master_relay.writePin(RELAY_OUT0_PIN, RELAY_OFF);
  //===============================================================================================
  state = 0;
  //=============================================================================================== 

  //===============================================================================================
  SerialDebug.println();
  SerialDebug.println("ET-ESP32(WROVER)RS485 V2.....Ready");
  //===============================================================================================

  //===============================================================================================
  print_menu_test(); 
  //===============================================================================================
}

void loop() 
{
  if(SerialDebug.available() > 0)
  {
    //=============================================================================================
    int rx_command;
    //============================================================================================= 

    //=============================================================================================
    rx_command = SerialDebug.read();
    //=============================================================================================
    switch(rx_command)
    {
      case '0':
        test_sw_led_opto_relay();
      break;
      
      case '1':
        test_i2c_rtc_ds3231();
      break;

      case '2':
        test_i2c_eeprom();
      break;

      case '3':
        test_i2c_sht31();
      break;
      
      case '4':
        test_i2c_adc_mcp3423();
      break;
      
      case '5':
        test_rs485();
      break;

      case '6':
        test_wifi();
      break;
      
      case 0x0D:
        print_menu_test();
      break;

      default:
        print_menu_test();
      break;
    }
  }  
}

void print_menu_test(void)
{
  //===============================================================================================
  SerialDebug.println();
  SerialDebug.println();
  SerialDebug.println("================================================================");
  SerialDebug.println("ET-ESP32(WROVER) RS485 V2 Hardware Test");
  SerialDebug.println("================================================================");
  SerialDebug.println(" 0. Test User Switch & LED");
  SerialDebug.println(" 1. Test I2C Interface RTC:DS3231");
  SerialDebug.println(" 2. Test I2C Interface EEPROM:24LC16B");
  SerialDebug.println(" 3 Test I2C Interface Sensor SHT31");
  SerialDebug.println(" 4. Test I2C Interface ADC MCP3423");
  SerialDebug.println(" 5. Test RS485 & Relay");
  SerialDebug.println(" 6. Test WiFi Connect");
  SerialDebug.println("================================================================");
  SerialDebug.print(" Select[0..5] for Test...");
  //===============================================================================================  
}

//=================================================================================================
// Test User Switch & LED & OPTO & Relay
//=================================================================================================
void test_sw_led_opto_relay(void)
{
  //===============================================================================================
  int this_switch;
  int last_switch;
  //===============================================================================================
  
  //===============================================================================================
  SerialDebug.println();
  SerialDebug.println("================================================================");
  SerialDebug.println();
  SerialDebug.println("================================================================");
  SerialDebug.println("Test User Switch & LED");
  SerialDebug.println("Test LED by Toggle ON/OFF");
  SerialDebug.println("Test Switch by Press/Release Switch For Test...");
  SerialDebug.println("================================================================");
  //===============================================================================================
  
  //===============================================================================================
  while(1)
  {
    //=============================================================================================
    // Blink ON/OFF LED
    //=============================================================================================
    if((millis() - lastGetI2CSensorTime) > 1000ul)                                                // 1-Second
    {
      //===========================================================================================
      digitalWrite(LED_PIN, !digitalRead(LED_PIN));                                               // Toggle LED ON/OFF
      //===========================================================================================
      lastGetI2CSensorTime = millis();
      //===========================================================================================
    }
    //=============================================================================================

    //=============================================================================================
    this_switch = digitalRead(USER_SW_PIN);
    //=============================================================================================
    if(this_switch != last_switch)
    {
      SerialDebug.print("USER SWITCH = ");
      SerialDebug.println(this_switch ? "Release" : "Press");
      last_switch = this_switch;
    }
    //=============================================================================================
  }
  //===============================================================================================
}
//=================================================================================================

//=================================================================================================
// Test I2C Interface RTC:DS3231
//=================================================================================================
void test_i2c_rtc_ds3231(void)
{
  //===============================================================================================
  SerialDebug.println();
  SerialDebug.println("================================================================");
  SerialDebug.println();
  SerialDebug.println("Initialize DS3231");
  //===============================================================================================
  myRTC.begin();
  //===============================================================================================
  if(myRTC.lostPower()) 
  {
    SerialDebug.println("RTC lost power, lets set the time!");
    myRTC.adjust(DateTime(F(__DATE__), F(__TIME__)));                                            // Setup RTC from date & time this sketch was compiled
  }
  //===============================================================================================
  
  //===============================================================================================
  myRTC.armAlarm1(false);
  myRTC.clearAlarm1();
  //===============================================================================================
  myRTC.armAlarm2(false);
  myRTC.clearAlarm2();
  //===============================================================================================
  
  //===============================================================================================
  myRTC.setAlarm1(0, 0, 0, 0, DS3231_EVERY_SECOND);                                              // Alarm Every Second
  //===============================================================================================
  //===============================================================================================
  SerialDebug.println("Initial RTC:DS3231....Complete");
  //===============================================================================================

  while(1)
  {
    //=============================================================================================
    if(myRTC.isAlarm1(false))
    {
      //===========================================================================================
      myTimeNow = myRTC.now();
      //===========================================================================================
      SerialDebug.print("RTC Time : ");
      SerialDebug.print(daysOfTheWeek[myTimeNow.dayOfTheWeek()]);
      SerialDebug.print(',');
      SerialDebug.print(myTimeNow.day());
      SerialDebug.print('/');
      SerialDebug.print(myTimeNow.month());
      SerialDebug.print('/');
      SerialDebug.print(myTimeNow.year());
      SerialDebug.print(" ");
      SerialDebug.print(myTimeNow.hour());
      SerialDebug.print(':');
      SerialDebug.print(myTimeNow.minute());
      SerialDebug.print(':');
      SerialDebug.print(myTimeNow.second());
      SerialDebug.println();
      //===========================================================================================
                          
      //===========================================================================================
      myRTC.clearAlarm1();
      //===========================================================================================
    }
  }
}

//=================================================================================================
// Test I2C Interface EEPROM 24LC16
//=================================================================================================
void test_i2c_eeprom(void)
{
  //=============================================================================================== 
  SerialDebug.flush();
  SerialDebug.println();
  SerialDebug.println("================================================================");
  SerialDebug.println();
  SerialDebug.println("Start 24LC16B Witre");
  //===============================================================================================
  char eep_config[] = "hello...this is data from the eeprom 24LC16B";
  myConfig.write(0, (byte *)eep_config, sizeof(eep_config));                                     // Write Address 0...
  delay(100);
  //===============================================================================================
  SerialDebug.println("Start 24LC16B Write = hello...this is data from the eeprom 24LC16B");
  SerialDebug.println("Write 24LC16B Complete");
  SerialDebug.println();
  //===============================================================================================
  SerialDebug.println("Start 24LC16B Read");
  //===============================================================================================
  int addr=0;                                                                                    // first address
  //===============================================================================================
  byte b =  myConfig.read_byte(addr);                                                            // access the first address from the memory
  //===============================================================================================
  while(b!=0)
  {
    SerialDebug.print((char)b);                                                                  // print content to serial port
    addr++;                                                                                      // increase address
   b = myConfig.read_byte(addr);                                                                 // access an address from the memory
  }
  SerialDebug.println();
  SerialDebug.println("Read 24LC16B Complete");
  //===============================================================================================  
  while(1);
}
//=================================================================================================

//=================================================================================================
// Test I2C Interface ADC MCP3423
// CH1 = Battery Level
// CH2 = External Signal 0-5V/4..20mA
//=================================================================================================
void test_i2c_adc_mcp3423(void)
{
  //===============================================================================================
  SerialDebug.println();
  SerialDebug.println("================================================================");
  SerialDebug.println();
  SerialDebug.println("Initial MCP3423...Start");
  //===============================================================================================
  mcp3423_status = mcp3423.testConnection();
  //===============================================================================================
  SerialDebug.println(mcp3423_status ? "Initial MCP3423...Complete" : "Initial MCP3423...Error");
  //===============================================================================================  
  
  while(1)
  {
    if((millis() - lastGetI2CSensorTime) > 1000ul)                                                // 1-Second
    {
      //===========================================================================================
      // Start of  I2C ADC(MCP3423) Service
      //===========================================================================================
      mcp3423.setConfig(MCP342X_CHANNEL_1 |
                        MCP342X_MODE_CONTINUOUS |
                        MCP342X_SIZE_16BIT |
                        MCP342X_GAIN_1X);
      //===========================================================================================
      //SerialDebug.print("CH1 Config = "); 
      //SerialDebug.println(mcp3423.getConfigRegShdw(), HEX);                                       // 0x18(0011 1000=0:Update Reg,00:CH1,1:Continue,10:16Bit,00:1X)     
      //===========================================================================================
      mcp3423.startConversion(MCP342X_CHANNEL_1);                                                 // Start Conversion(-32768 to +32767)
      mcp3423.getResult(&adc1_value);      
      //===========================================================================================           
    
      //=========================================================================================== 
      adc1_voltage = ((2.048/65535.0) * (float)adc1_value) * 2;
      //===========================================================================================
      SerialDebug.println();
      SerialDebug.print("ADC1 = ");
      SerialDebug.print(adc1_voltage,3);
      SerialDebug.print(" Volt : ");
      //===========================================================================================   
    
      //===========================================================================================
      mcp3423.setConfig(MCP342X_CHANNEL_2 |
                        MCP342X_MODE_CONTINUOUS |
                        MCP342X_SIZE_16BIT |
                        MCP342X_GAIN_1X);
      //=========================================================================================== 
      //SerialDebug.print("CH2 Config = "); 
      //SerialDebug.println(mcp3423.getConfigRegShdw(), HEX);                                       // 0x38(0011 1000=0:Update Reg,01:CH2,1:Continue,10:16Bit,00:1X)   
      //===========================================================================================
      mcp3423.startConversion(MCP342X_CHANNEL_2);                                                 // Start Conversion(-32768 to +32767)
      mcp3423.getResult(&adc2_value);    
      //===========================================================================================                  
      adc2_voltage = (2.048/65535.0) * (float)adc2_value * 2;                                     // 4..20mA : 0.4...2.0V)
      //===========================================================================================  
      SerialDebug.print("ADC2 = ");
      SerialDebug.print(adc2_voltage,3);
      SerialDebug.println(" Volt");
      //=========================================================================================== 
      //===========================================================================================
      // End of  I2C ADC(MCP3423) Service
      //===========================================================================================

      //===========================================================================================
      lastGetI2CSensorTime = millis();
      //===========================================================================================
    }
  }
}
//=================================================================================================

//=================================================================================================
// Test I2C Interface SHT31 Sensor
//=================================================================================================
void test_i2c_sht31(void)
{
  //===============================================================================================
  SerialDebug.println();
  SerialDebug.println("================================================================");
  SerialDebug.println();
  SerialDebug.println("Initial SHT31...Start");
  //===============================================================================================
  if(!sht31.begin(0x44))
  {
    if(!sht31.begin(0x45))
    {
      //===========================================================================================
      SerialDebug.println("Initial SHT31...Error");
      //===========================================================================================
    }
    else
    {
      SerialDebug.println("Found SHT31...0x45");
    }
  }
  else
  {
    SerialDebug.println("Found SHT31...0x44");
  }
  //===============================================================================================
  sht31_temperature = sht31.readTemperature();                                                    // *C
  sht31_humidity = sht31.readHumidity();                                                          // %RH
  //===============================================================================================
  

  //===============================================================================================
  while(1)
  {
    if((millis() - lastGetI2CSensorTime) > 1000ul)                                                // 1-Second
    {
      //===========================================================================================
      sht31_temperature = sht31.readTemperature();                                                // *C
      sht31_humidity = sht31.readHumidity();                                                      // %RH
      //===========================================================================================
      //===========================================================================================
      if(!isnan(sht31_temperature)) 
      {
        //=========================================================================================
        SerialDebug.print("SHT31 Temperature = ");
        SerialDebug.print(sht31_temperature,1);
        SerialDebug.println(" *C");
        //=========================================================================================
      }
      else 
      { 
        //=========================================================================================
        SerialDebug.println("SHT31 Temperature...Error");
        //=========================================================================================
      }
      //===========================================================================================
      if(!isnan(sht31_humidity)) 
      {
        //=========================================================================================
        SerialDebug.print("SHT31 Humidity = ");
        SerialDebug.print(sht31_humidity,1);
        SerialDebug.println(" %RH");
        //=========================================================================================
      }
      else 
      { 
        //=========================================================================================
        SerialDebug.println("SHT31 Humidity...Error");
        //=========================================================================================
      }
      SerialDebug.println();
      //===========================================================================================
      
      //===========================================================================================
      lastGetI2CSensorTime = millis();
      //===========================================================================================
    }
  }
  //===============================================================================================
}
//=================================================================================================

//=================================================================================================
// Test RS485
//=================================================================================================
void test_rs485(void)
{
  //===============================================================================================
  SerialDebug.flush();
  SerialDebug.println();
  SerialDebug.println("================================================================");
  SerialDebug.println("Demo RS485 Control Relay(PCF8574/A) Test");
  SerialDebug.println("================================================================");
  SerialDebug.println("Send RS485 *99:0=0<Cr> Control Relay[0] & P4 OFF");
  SerialDebug.println("Send RS485 *99:0=1<Cr> Control Relay[0] & P4 ON");
  SerialDebug.println("Send RS485 *99:1=0<Cr> Control Relay[1] & P5 OFF");
  SerialDebug.println("Send RS485 *99:1=1<Cr> Control Relay[1] & P5 ON");
  SerialDebug.println("Send RS485 *99:2=0<Cr> Control Relay[2] & P6 OFF");
  SerialDebug.println("Send RS485 *99:2=1<Cr> Control Relay[2] & P6 ON");
  SerialDebug.println("Send RS485 *99:3=0<Cr> Control Relay[3] & P7 OFF");
  SerialDebug.println("Send RS485 *99:3=1<Cr> Control Relay[3] & P7 ON");
  SerialDebug.println("================================================================");
  //===============================================================================================
  
  //===============================================================================================
  // Initial RS485
  //===============================================================================================
  SerialRS485.begin(9600, SERIAL_8N1, SerialRS485_RX_PIN, SerialRS485_TX_PIN);
  while(!SerialRS485);
  //===============================================================================================
  SerialRS485.println();
  SerialRS485.println("My RS485 Slave ID:99");
  SerialRS485.println("Send RS485 *99:0=0<Cr> Control Relay[0] & P4 OFF");
  SerialRS485.println("Send RS485 *99:0=1<Cr> Control Relay[0] & P4 ON");
  SerialRS485.println("Send RS485 *99:1=0<Cr> Control Relay[1] & P5 OFF");
  SerialRS485.println("Send RS485 *99:1=1<Cr> Control Relay[1] & P5 ON");
  SerialRS485.println("Send RS485 *99:2=0<Cr> Control Relay[2] & P6 OFF");
  SerialRS485.println("Send RS485 *99:2=1<Cr> Control Relay[2] & P6 ON");
  SerialRS485.println("Send RS485 *99:3=0<Cr> Control Relay[3] & P7 OFF");
  SerialRS485.println("Send RS485 *99:3=1<Cr> Control Relay[3] & P7 ON");
  //===============================================================================================
  
  //===============================================================================================
  while(1)
  {
    //===============================================================================================
    // Start of Receive & Service RS485 Command
    //===============================================================================================
    if(SerialRS485.available() > 0)
    {  
      rs485_chr = SerialRS485.read();
    
      if(rs485_chr == STX_CODE)                                                                     // Verify Start of Command Header
      {
        //===========================================================================================
        // Reset Packet Frame Reset
        //===========================================================================================
        rs485_cmd_head = 1;                                                                         // Command Header Not Complete  
        rs485_cmd_cnt = 0;                                                                          // Re-Start Command Count
        for(int i=0; i<sizeof(rs485.cmd_buff); i++)
        {
          rs485.cmd_buff[i] = '\0';
        }
        rs485_cmd_ptr = &rs485.cmd_buff[0];
        //===========================================================================================
      } 

      //Start of Receive & Verify RS485 Packet Command
      if((rs485_cmd_head == 1) && (rs485_cmd_cnt <=(sizeof(rs485.cmd_buff))))
      { 
        *rs485_cmd_ptr = rs485_chr;                                                                 // Save Character 
        rs485_cmd_ptr++;                                                                            // Next Pointer         
        rs485_cmd_cnt++;  

        //===========================================================================================
        // Start of Analysis & Service RS485 Command Packet   
        //===========================================================================================
        if(rs485_chr == 0x0D)
        {           
          //=========================================================================================
          // <STX><ID0><ID1><Sep1><Relay><Sep2><Operate><Enter>
          // <STX><ID0><ID1><:><0><=><0><CR>   OFF Relay[0]
          // <STX><ID0><ID1><:><0><=><1><CR>   ON  Relay[0]
          // <STX><ID0><ID1><:><1><=><0><CR>   OFF Relay[1]
          // <STX><ID0><ID1><:><1><=><1><CR>   ON  Relay[1]
          // <STX><ID0><ID1><:><2><=><0><CR>   OFF Relay[2]
          // <STX><ID0><ID1><:><2><=><1><CR>   ON  Relay[2]
          // <STX><ID0><ID1><:><3><=><0><CR>   OFF Relay[3]
          // <STX><ID0><ID1><:><3><=><1><CR>   ON  Relay[3]
          //=========================================================================================
          if((rs485.control_relay.head      == STX_CODE)&&                                        // head : 0x02
        
             (rs485.control_relay.id[0]     == '9')&&                                             // id[0]:0..9
             (rs485.control_relay.id[1]     == '9')&&                                             // id[1]:0..9
           
             (rs485.control_relay.sep1      == SEP1)&&                                            // sep1 : ':' 
           
             ((rs485.control_relay.relay    == '0')||
              (rs485.control_relay.relay    == '1')||
              (rs485.control_relay.relay    == '2')||
              (rs485.control_relay.relay    == '3'))&&                                            // '0':Relay[0],'1':Relay[1],'2':Relay[2],'3':Relay[3]
           
             (rs485.control_relay.sep2      == SEP2)&&                                            // sep2 : '='
           
             ((rs485.control_relay.operate  == '0')||
              (rs485.control_relay.operate  == '1'))&&                                            // operate('0':OFF,'1':ON)
           
             (rs485.control_relay.enter     == END_CODE))                                         // Enter:0x0D = End of Packet
          {
            //=====================================================================================
            if((rs485.control_relay.relay=='0')&&
               (rs485.control_relay.operate=='0'))                                       
            {
              //===================================================================================
              master_relay.writePin(RELAY_OUT0_PIN, RELAY_OFF);
              master_relay.writePin(RELAY_OUT4_PIN, RELAY_OFF);
              //===================================================================================
              // Start of RS485 Test
              //===================================================================================
              SerialRS485.print("Slave ID:");
              SerialRS485.write(rs485.control_relay.id[0]);
              SerialRS485.write(rs485.control_relay.id[1]);
              SerialRS485.println("...Relay[0] & P4 : OFF");
              //===================================================================================
              // End of RS485 Test
              //===================================================================================
            }
            //=====================================================================================
            
            //=====================================================================================
            else if((rs485.control_relay.relay=='0')&&
                    (rs485.control_relay.operate=='1'))                                       
            {
              //===================================================================================
              master_relay.writePin(RELAY_OUT0_PIN, RELAY_ON);
              master_relay.writePin(RELAY_OUT4_PIN, RELAY_ON);
              //===================================================================================
              SerialRS485.print("Slave ID:");
              SerialRS485.write(rs485.control_relay.id[0]);
              SerialRS485.write(rs485.control_relay.id[1]);
              SerialRS485.println("...Relay[0] & P4 : ON");
              //===================================================================================
            }
            //=====================================================================================

            //=====================================================================================
            else if((rs485.control_relay.relay=='1')&&
                    (rs485.control_relay.operate=='0'))                                       
            {
              //===================================================================================
              master_relay.writePin(RELAY_OUT1_PIN, RELAY_OFF);
              master_relay.writePin(RELAY_OUT5_PIN, RELAY_OFF);
              //===================================================================================
              // Start of RS485 Test
              //===================================================================================
              SerialRS485.print("Slave ID:");
              SerialRS485.write(rs485.control_relay.id[0]);
              SerialRS485.write(rs485.control_relay.id[1]);
              SerialRS485.println("...Relay[1] & P5 : OFF");
              //===================================================================================
              // End of RS485 Test
              //===================================================================================
            }
            //=====================================================================================
            
            //=====================================================================================
            else if((rs485.control_relay.relay=='1')&&
                    (rs485.control_relay.operate=='1'))                                       
            {
              //===================================================================================
              master_relay.writePin(RELAY_OUT1_PIN, RELAY_ON);
              master_relay.writePin(RELAY_OUT5_PIN, RELAY_ON);
              //===================================================================================
              SerialRS485.print("Slave ID:");
              SerialRS485.write(rs485.control_relay.id[0]);
              SerialRS485.write(rs485.control_relay.id[1]);
              SerialRS485.println("...Relay[1] & P5 : ON");
              //===================================================================================
            }
            //=====================================================================================

            //=====================================================================================
            else if((rs485.control_relay.relay=='2')&&
                    (rs485.control_relay.operate=='0'))                                       
            {
              //===================================================================================
              master_relay.writePin(RELAY_OUT2_PIN, RELAY_OFF);
              master_relay.writePin(RELAY_OUT6_PIN, RELAY_OFF);
              //===================================================================================
              // Start of RS485 Test
              //===================================================================================
              SerialRS485.print("Slave ID:");
              SerialRS485.write(rs485.control_relay.id[0]);
              SerialRS485.write(rs485.control_relay.id[1]);
              SerialRS485.println("...Relay[2] & P6 : OFF");
              //===================================================================================
              // End of RS485 Test
              //===================================================================================
            }
            //=====================================================================================
            
            //=====================================================================================
            else if((rs485.control_relay.relay=='2')&&
                    (rs485.control_relay.operate=='1'))                                       
            {
              //===================================================================================
              master_relay.writePin(RELAY_OUT2_PIN, RELAY_ON);
              master_relay.writePin(RELAY_OUT6_PIN, RELAY_ON);
              //===================================================================================
              SerialRS485.print("Slave ID:");
              SerialRS485.write(rs485.control_relay.id[0]);
              SerialRS485.write(rs485.control_relay.id[1]);
              SerialRS485.println("...Relay[2] & P6 : ON");
              //===================================================================================
            }
            //=====================================================================================

            //=====================================================================================
            else if((rs485.control_relay.relay=='3')&&
                    (rs485.control_relay.operate=='0'))                                       
            {
              //===================================================================================
              master_relay.writePin(RELAY_OUT3_PIN, RELAY_OFF);
              master_relay.writePin(RELAY_OUT7_PIN, RELAY_OFF);
              //===================================================================================
              // Start of RS485 Test
              //===================================================================================
              SerialRS485.print("Slave ID:");
              SerialRS485.write(rs485.control_relay.id[0]);
              SerialRS485.write(rs485.control_relay.id[1]);
              SerialRS485.println("...Relay[3] & P7 : OFF");
              //===================================================================================
              // End of RS485 Test
              //===================================================================================
            }
            //=====================================================================================
            
            //=====================================================================================
            else if((rs485.control_relay.relay=='3')&&
                    (rs485.control_relay.operate=='1'))                                       
            {
              //===================================================================================
              master_relay.writePin(RELAY_OUT3_PIN, RELAY_ON);
              master_relay.writePin(RELAY_OUT7_PIN, RELAY_ON);
              //===================================================================================
              SerialRS485.print("Slave ID:");
              SerialRS485.write(rs485.control_relay.id[0]);
              SerialRS485.write(rs485.control_relay.id[1]);
              SerialRS485.println("...Relay[3] & P7 : ON");
              //===================================================================================
            }
            //=====================================================================================
            
          }
          //=======================================================================================
          // Clear RS485 Buffer
          //=======================================================================================
          rs485_cmd_head = 0;                                                                    // Command Header Not Complete  
          rs485_cmd_cnt = 0;                                                                     // Re-Start Command Count
          for(int i=0; i<sizeof(rs485.cmd_buff); i++)
          {
            rs485.cmd_buff[i] = '\0';
          }
          rs485_cmd_ptr = &rs485.cmd_buff[0];   
          //=======================================================================================
        } 
        //=========================================================================================
        // End of Analysis & Service RS485 Command Packet   
        //=========================================================================================
      }
    }
    //=============================================================================================
  }
  //===============================================================================================

}
//=================================================================================================

void test_wifi()
{
  //===============================================================================================
  SerialDebug.flush();
  SerialDebug.println();
  SerialDebug.println("================================================================");
  SerialDebug.println("Test WiFi Connect");
  SerialDebug.println("================================================================");
  //===============================================================================================
  
  //===============================================================================================
  // Start of Test WiFi Connect to Router
  //===============================================================================================
  SerialDebug.println();
  SerialDebug.print("WiFi Connecting to ");
  SerialDebug.println(wifissid);
  //===============================================================================================

  //===============================================================================================
  if(WiFi.status() != WL_CONNECTED)
  {
    WiFi.disconnect(true);
    delay(1000);
    WiFi.begin(wifissid, password);
    while(WiFi.status() != WL_CONNECTED) 
    {
      delay(500);
      SerialDebug.print(".");
    }
  }
  //===============================================================================================
  SerialDebug.println("");
  SerialDebug.println("WiFi connected");
  SerialDebug.println("IP address: ");
  SerialDebug.println(WiFi.localIP());  
  //===============================================================================================
  // End of Test WiFi Connect to Router
  //===============================================================================================
  SerialDebug.println("WiFi Connect...Ready");
  while(1);
}


