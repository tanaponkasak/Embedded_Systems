/*******************************************************************************
 * ET-ESP32(WROVER) RS485 V2 
 * Tools->Board:"ESP32 Wrover Module"
 *******************************************************************************
 * I2C Interface & I2C Bus
 * -> IO22                = I2C_SCL
 * -> IO21                = I2C_SDA
 * -> I2C RTC:DS3231      = I2C Address : 0x68:1100100(x)
 * -> I2C EEPROM 24LC16   = I2C Address : 0x50:1010000(x)
 * -> I2C ADC MCP3423     = I2C Address : 0x6D:1100101(x)
 * -> I2C Sensor:BME280   = I2C Address : 0x76:1110110(x)
 * -> I2C Sebsor:SHT31    = I2C Address : 0x44:1000100(x)/0x45:1010101(x)
 * SPI Interface SD Card
 * -> SD_CS               = IO4
 * -> SPI_MISO            = IO19
 * -> SPI_MOSI            = IO23
 * -> SPI_SCK             = IO18
 * UART2 RS485 Half Duplex Auto Direction
 * -> IO26                = RX2
 * -> IO27                = TX2
 * User Switch
 * -> IO36                = USER_SW
 * RTC Interrupt
 * -> IO39                = RTC_INT#
 *******************************************************************************/
 
//=================================================================================================
#include <Wire.h> 
//=================================================================================================

//=================================================================================================
// Start of Default Hardware : ET-ESP32(WROVER) RS485 V2
//=================================================================================================
// Remap Pin USART -> C:\Users\Admin\Documents\Arduino\hardware\espressif\esp32\cores\esp32\HardwareSerial.cpp
//                    C:\Users\Admin\AppData\Local\Arduino15\packages\esp32\hardware\esp32\1.0.0\cores\esp32\HardwareSerial.cpp
//=================================================================================================
#include <HardwareSerial.h>
//=================================================================================================
#define SerialDebug           Serial                                                              // USB Serial(Serial0)
//=================================================================================================
#define SerialRS485_RX_PIN    26
#define SerialRS485_TX_PIN    27
#define SerialRS485           Serial2                                                             // Serial2(IO27=TXD,IO26=RXD)
//=================================================================================================
#define SerialLora_RX_PIN     14
#define SerialLora_TX_PIN     13
#define SerialLora            Serial1                                                             // Serial1(IO13=TXD,IO14=RXD)
//=================================================================================================
#define LORA_RES_PIN          33                                                                  // ESP32-WROVER :IO33(LoRa-RESET)
#define LORA_RES_PRESS        LOW
#define LORA_RES_RELEASE      HIGH
//=================================================================================================
#define I2C_SCL_PIN           22                                                                  // ESP32-WROVER : IO22(SCL1)
#define I2C_SDA_PIN           21                                                                  // ESP32-WROVER : IO21(SDA1)
//=================================================================================================
#define LED_PIN               2                                                                   // ESP-WROVER  : IO2
#define LedON                 1
#define LedOFF                0
//=================================================================================================
#define USER_SW_PIN           36                                                                  // ESP32-WROVER :IO36
#define SW_PRESS              LOW
#define SW_RELEASE            HIGH 
//=================================================================================================
#define RTC_INT_PIN           39                                                                  // ESP32-WROVER :IO39
#define RTC_INT_ACTIVE        LOW
#define RTC_INT_DEACTIVE      HIGH 
//=================================================================================================
// End of Default Hardware : ET-ESP32(WROVER) RS485 V2
//=================================================================================================

//=================================================================================================
// Demo RS485 Modbus RTU Interface Soil Moisture Sensor(SOIL MOISTURE-H MODBUS RTU)
//=================================================================================================
// Red    = +5V or 24V(3.6-30VDC)
// Black  = GND
// White  = RS485(B)
// Yellow = RS485(A)
// Green  = NC
//=================================================================================================
#include "ETT_ModbusRTU.h"
//=================================================================================================

//=================================================================================================
// Data Array For Modbus Network Sharing for Soil Moisture-H Modbus RTU
//=================================================================================================
// Input[1]   = Soil Moisture INT16 Value
//=================================================================================================
uint16_t ModbusSoilMoisture[1];   
//=================================================================================================

//=================================================================================================
// Holding[512] = Moisture Sensor Slave ID
//=================================================================================================                                                              
uint16_t ModbusSlaveID[1]; 
//=================================================================================================
uint8_t u8state;                                                                                  // machine state
uint8_t u8query;                                                                                  // pointer to message query
//=================================================================================================

//=================================================================================================
uint16_t moisture_int16_value;
//=================================================================================================
float moisture_float_value;
//=================================================================================================

/**
 *  Modbus object declaration
 *  u8id : node id = 0 for master, = 1..247 for slave
 *  u8serno : serial port (use 0 for Serial)
 *  u8txenpin : 0 for RS-232 and USB-FTDI 
 *               or any pin number > 1 for RS-485
 */
Modbus master(0,                                                                                  // node id = 0(master)
              SerialRS485);                                                                       // Serial2 = RS485 Modbus Auto Direction

/**
 * This is an structe which contains a query to an slave device
 */
//================================================================================================= 
modbus_t telegram[2];                                                                             // 2-Modbus Frame Service
//=================================================================================================
unsigned long u32wait;
//=================================================================================================
unsigned long lastScanBusTime = 0;
//=================================================================================================

void setup() 
{
  //===============================================================================================
  // Start of Initial Default Hardware : ET-ESP32(WROVER) RS485 V2
  //===============================================================================================
  pinMode(LED_PIN, OUTPUT);
  digitalWrite(LED_PIN, LedOFF);
  //===============================================================================================
  pinMode(USER_SW_PIN,INPUT_PULLUP);
  pinMode(RTC_INT_PIN,INPUT_PULLUP);
  //===============================================================================================
  Wire.begin(I2C_SDA_PIN,I2C_SCL_PIN);                                                      
  //===============================================================================================
  SerialDebug.begin(115200);
  while(!SerialDebug);
  //===============================================================================================
  SerialRS485.begin(9600, SERIAL_8N1, SerialRS485_RX_PIN, SerialRS485_TX_PIN);
  while(!SerialRS485);
  //===============================================================================================
  // End of Initial Default Hardware : ET-ESP32(WROVER) RS485 V2
  //===============================================================================================

  //===============================================================================================
  SerialDebug.println();
  SerialDebug.println("ET-ESP32(WROVER)RS485 V2.....Ready");
  //===============================================================================================

  //===============================================================================================
  SerialDebug.println();
  SerialDebug.println("ET-ESP32(WROVER)RS485 V2...Demo RS485 Modbus RTU");
  SerialDebug.println("Interface...Soil Moisture-H Modbus RTU");
  //===============================================================================================

  //===============================================================================================
  // telegram 0: Read Input Register
  //===============================================================================================
  telegram[0].u8id = 1;                                                                           // Slave Address
  //===============================================================================================
  telegram[0].u8fct = 4;                                                                          // Function 0x04(Read Input Register)
  telegram[0].u16RegAdd = 1;                                                                      // Start Address Read(0x0001:SoilMoisture)
  telegram[0].u16CoilsNo = 1;                                                                     // Number of Register to Read(8 Input Register)
  telegram[0].au16reg = ModbusSoilMoisture;                                                       // Pointer to Buffer Save Input Register
  //===============================================================================================
  
  //===============================================================================================
  // telegram 1: Read Holding Register
  //===============================================================================================
  telegram[1].u8id = 1;                                                                           // Slave Address
  //===============================================================================================
  telegram[1].u8fct = 3;                                                                          // Function 0x03(Read Holding Register)
  telegram[1].u16RegAdd = 512;                                                                    // Start Address Read(0x0200:512)  
  telegram[1].u16CoilsNo = 1;                                                                     // Number of Register to Read(1 Holding Register)
  telegram[1].au16reg = ModbusSlaveID;                                                            // Pointer to Buffer Save Holding Register
  //===============================================================================================
  
  //===============================================================================================
  master.begin(SerialRS485);                                                                      // Mosbus Interface
  master.setTimeOut(2000);                                                                        // if there is no answer in 2000 ms, roll over
  u32wait = millis() + 2000;
  u8state = u8query = 0; 
  //===============================================================================================
  lastScanBusTime = millis();
  //===============================================================================================
}

void loop() 
{
  switch( u8state ) 
  {
    case 0: 
      //===========================================================================================
      if (millis() > u32wait) u8state++;                                                          // wait state
      //===========================================================================================
    break;
    
    case 1: 
      //===========================================================================================
      master.query(telegram[u8query]);                                                            // send query (only once)
      u8state++;
      u8query++;
      //===========================================================================================
      if(u8query > 1) u8query = 0;                                                                // telegram[0],telegram[1], ----> ,telegram[0]
      //===========================================================================================
    break;
    
    case 2:
      //===========================================================================================
      if(master.poll())                                                                           // check incoming messages
      {
        //=========================================================================================
        // Start of Soil Moisture-H Modbus RTU Service Data
        //=========================================================================================
        SerialDebug.println();
        SerialDebug.println("ET-ESP32(WROVER)RS485 V2 & SOIL MOISTURE-H MODBUS RTU");
        //=========================================================================================
        
        //=========================================================================================
        // Modbus Holding Register
        //=========================================================================================
        SerialDebug.print("Soil Moisture Modbus Slave ID(1) = ");
        SerialDebug.println(ModbusSlaveID[0]);
        //=========================================================================================
        
        if(ModbusSlaveID[0] == 1)                                                                 // if Modbus Device Found
        {
          //=======================================================================================
          // Modbus Input Register
          // 1 = Soil Moisture/100
          //=======================================================================================
          moisture_int16_value = ModbusSoilMoisture[0];                                           // Soil Moisture/100
          //=======================================================================================
          SerialDebug.print("Soil Moisture Value = ");
          SerialDebug.print(moisture_int16_value);                                                // Soil Moisture/100
          SerialDebug.print(" : ");
          SerialDebug.print((float)moisture_int16_value/100.0);                                   // Soil Moisture
          SerialDebug.println("%RH");
          //=======================================================================================
        }
        
        //=========================================================================================
        // End of Soil Moisture-H Modbus RTU Service Data
        //=========================================================================================
      }  
      //===========================================================================================

      //===========================================================================================
      if(master.getState() == COM_IDLE) 
      {
        u8state = 0;
        u32wait = millis() + 1000; 
      }
      //===========================================================================================
      
      /*
      else 
      */ 
    break;
  }
}
